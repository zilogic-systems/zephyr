/dts-v1/;

#include <nxp/nxp_lpc17xx.dtsi>

/ {
	model = "ZKit-ARM-1769 board";
	compatible = "nxp,lpc17xx", "nxp,lpc";
	
	chosen {
		zephyr,sram = &sram0;
		zephyr,flash = &flash0;
		zephyr,console = &uart0;
	};
};

&uart0 {
       status = "ok";
       current-speed = <115200>;
};

