## arch/arm/soc/nxp_lpc/lpc17xx/Kconfig.defconfig.series
```kconfig
if SOC_SERIES_LPC17XX

config SOC_SERIES
	default "lpc17xx"

config NUM_IRQS
	int
	# must be >= the highest interrupt number used
	default 40

gsource "arch/arm/soc/nxp_lpc/lpc17xx/Kconfig.defconfig.lp*"

endif # SOC_SERIES_LPC17XX
```

## arch/arm/soc/nxp_lpc/lpc17xx/Kconfig.series
```kconfig
config SOC_SERIES_LPC17XX
	bool "LPC LPC17xx Series MCU"
	select SOC_FAMILY_LPC
	select CPU_HAS_SYSTICK
	help
	  Enable support for LPC LPC17XX MCU series
```

## boards/arm/zkit_arm_1769/Kconfig.board
```kconfig
config BOARD_ZKIT_ARM_1769
	bool "ZKit-ARM-1769"
	select HAS_DTS
	select HAS_DTS_SPI
	depends on SOC_SERIES_LPC17XX
```

## boards/arm/zkit_arm_1769/Kconfig.defconfig
```kconfig
if BOARD_ZKIT_ARM_1769

config BOARD
	default "ZKit-ARM-1769"

if UART_LPC17XX

config UART_LPC17XX_PORT_0
	def_bool y if UART_CONSOLE

endif # UART_LPC17XX
endif # BOARD_ZKIT_ARM_1769
```

## boards/arm/zkit_arm_1769/zkit_arm_1769_defconfig
```kconfig
CONFIG_ARM=y
CONFIG_SOC_LPC1769=y
CONFIG_SOC_SERIES_LPC17XX=y
CONFIG_BOARD_ZKIT_ARM_1769=y
CONFIG_CONSOLE=y
CONFIG_UART_CONSOLE=y
CONFIG_SERIAL=y
CONFIG_CORTEX_M_SYSTICK=y
CONFIG_PINMUX=y
CONFIG_SPI=y
CONFIG_SPI_1=y
CONFIG_SYS_CLOCK_HW_CYCLES_PER_SEC=120000000
```

## drivers/clock_control/Kconfig.lpc17xx
```kconfig
# Kconfig - LPC17XX CCM
#
# Copyright (c) 2018, Zilogic Systems.
#
# SPDX-License-Identifier: Apache-2.0
#

menuconfig CLOCK_CONTROL_LPC17XX
	bool
	prompt "LPC17XX CCM driver"
	depends on CLOCK_CONTROL
	help
	  Enable support for lpc ccm driver.
```

## drivers/ethernet/Kconfig.lm3s6965
```kconfig
# Kconfig - ETH_LM3S6965 Ethernet driver configuration options

#
# Copyright (c) 2018 Zilogic Systems
#
# SPDX-License-Identifier: Apache-2.0
#

menuconfig ETH_LM3S6965
	bool "LM3S6965 Ethernet Controller"
	depends on NET_L2_ETHERNET
	default n
	help
	  LM3S6965 on-board Ethernet Controller

if ETH_LM3S6965
config ETH_LM3S6965_NAME
	string "Driver's name"
	default "ETH_0"

config ETH_LM3S6965_MAC0
        hex "MAC Address Byte 0"
        default 0
        help
          This is the byte 0 of the MAC address.

config ETH_LM3S6965_MAC1
        hex "MAC Address Byte 1"
        default 0
        help
          This is the byte 1 of the MAC address.

config ETH_LM3S6965_MAC2
        hex "MAC Address Byte 2"
        default 0
        help
          This is the byte 2 of the MAC address.

config ETH_LM3S6965_MAC3
        hex "MAC Address Byte 3"
        default 0
        help
          This is the byte 3 of the MAC address.

config ETH_LM3S6965_MAC4
        hex "MAC Address Byte 4"
        default 0
        help
          This is the byte 4 of the MAC address.

config ETH_LM3S6965_MAC5
        hex "MAC Address Byte 5"
        default 0
        help
          This is the byte 5 of the MAC address.

endif #ETH_LM3S6965
```

## drivers/ethernet/Kconfig.stellaris
```kconfig
# Kconfig - ETH_STELLARIS Ethernet driver configuration options

#
# Copyright (c) 2018 Zilogic Systems
#
# SPDX-License-Identifier: Apache-2.0
#

menuconfig ETH_STELLARIS
	bool "Enable TI Stellaris MCU family ethernet driver."
	depends on NET_L2_ETHERNET
	default n
	help
	  Stellaris on-board Ethernet Controller

if ETH_STELLARIS
config ETH_STELLARIS_NAME
	string "Driver's name"
	default "ETH_0"

config ETH_STELLARIS_MAC0
        hex "MAC Address Byte 0"
        default 0
        help
          This is the byte 0 of the MAC address.

config ETH_STELLARIS_MAC1
        hex "MAC Address Byte 1"
        default 0
        help
          This is the byte 1 of the MAC address.

config ETH_STELLARIS_MAC2
        hex "MAC Address Byte 2"
        default 0
        help
          This is the byte 2 of the MAC address.

config ETH_STELLARIS_MAC3
        hex "MAC Address Byte 3"
        default 0
        help
          This is the byte 3 of the MAC address.

config ETH_STELLARIS_MAC4
        hex "MAC Address Byte 4"
        default 0
        help
          This is the byte 4 of the MAC address.

config ETH_STELLARIS_MAC5
        hex "MAC Address Byte 5"
        default 0
        help
          This is the byte 5 of the MAC address.

endif #ETH_STELLARIS
```

## drivers/gpio/Kconfig.lpc17xx
```kconfig
# Kconfig.lpc17xx - LPC GPIO Driver
#
# Copyright (c) 2018, Zilogic Systems
#
# SPDX-License-Identifier: Apache-2.0
#

menuconfig GPIO_LPC17XX
	bool "LPC GPIO driver"
	depends on GPIO
	help
	  Enable the LPC pinmux driver.
```

## drivers/i2c/Kconfig.lpc17xx
```kconfig
# Kconfig - LPC17XX I2C
#
# Copyright 2018, Zilogic Systems
#
# SPDX-License-Identifier: Apache-2.0

menuconfig I2C_LPC17XX
	bool "LPC17xx serial driver"
	depends on I2C
	select I2C_HAS_DRIVER
	help
	  This option enables the LPC17xx I2C driver.

menuconfig I2C_LPC17XX_PORT_0
	bool "Enable LPC17xx I2C 0"
 	depends on I2C_LPC17XX
 	help
 	  Enable support for I2C0 port in the driver. Say y here
	  if you want to use I2C0
```

## drivers/pinmux/Kconfig.lpc17xx
```kconfig
# Kconfig - pinmux for LPC17XX
#
# Copyright (c) 2018, Zilogic Systems
#
# SPDX-License-Identifier: Apache-2.0
#

menuconfig PINMUX_LPC17XX
	bool "LPC17XX pinmux driver"
	default n	
	help
	  Enable the LPC17XX pinmux driver.
```

## drivers/serial/Kconfig.lpc17xx
```kconfig
# Kconfig - LPC17XX UART
#
# Copyright 2018, Zilogic Systems
#
# SPDX-License-Identifier: Apache-2.0

menuconfig UART_LPC17XX
	bool "LPC17xx serial driver"
	depends on SERIAL
	select SERIAL_HAS_DRIVER
	select SERIAL_SUPPORT_INTERRUPT
	help
	  This option enables the LPC17xx serial driver.

menuconfig UART_LPC17XX_PORT_0
	bool "Enable LPC17xx UART 0"
	depends on UART_LPC17XX
	help
	  Enable support for UART0 port in the driver. Say y here
	  if you want to use UART0.
```

## drivers/spi/Kconfig.lpc17xx
```kconfig
# Kconfig - NXP LPC17XX SPI
#
# Copyright (c) 2018 Zilogic Systems.
# SPDX-License-Identifier: Apache-2.0

menuconfig SPI_LPC17XX
	bool "LPC17XX series SPI driver"
	depends on SOC_FAMILY_LPC17XX
	select HAS_DTS_SPI
	help
	  Enable support for the LPC17XX SPI driver.
```

## dts/bindings/clock/nxp,lpc17xx-ccm.yaml
```yaml
#
# Copyright (c) 2018, Zilogic Systems.
#
# SPDX-License-Identifier: Apache-2.0
#
---
title: LPC17XX CCM
id: nxp,lpc17xx-ccm
version: 0.1

description: >
    This binding gives a base representation of the LPC17xx Clock control

properties:
    compatible:
      type: string
      category: required
      description: compatible strings
      constraint: "nxp,lpc17xx-ccm"

    reg:
      type: array
      description: mmio register space
      generation: define
      category: required

    label:
      type: string
      category: required
      description: Human readable string describing the device (used by Zephyr for API name)
      generation: define

"#cells":
  - enable   # Periperal Clock to be Enabled
  - select   # Clock Div value select (0 = CCLK / 4, 1 = CCLK, 2 = CCLK / 2, 3 = CCLK / 8)

...
```

## dts/bindings/ethernet/ethernet.yaml
```yaml
#
# Copyright (c) 2018 Zilogic Systems
# SPDX-License-Identifier: Apache-2.0
#
---
title: Ethernet Base Structure
id: ethernet
version: 0.1

description: >
    This binding gives a base structures for all Ethernet devices

properties:
    local-mac-address:
      type: array
      category: required
      description: mac address
      generation: define
    label:
      type: string
      category: required
      description: Human readable string describing the device (used by Zephyr for API name)
      generation: define
...
```

## dts/bindings/ethernet/ti,stellaris-ethernet.yaml
```yaml
---
title: TI Stellaris Ethernet
id: ti,stellaris-ethernet
version: 0.1

description: >
    This binding gives a base representation of the TI Stellaris Ethernet

inherits:
  !include ethernet.yaml

properties:
    compatible:
      type: string
      category: required
      description: compatible strings
      constraint: "ti,stellaris-ethernet"
    reg:
      type: array
      description: mmio register space
      generation: define
      category: required
    interrupts:
      type: array
      category: required
      description: required interrupts
      generation: define
...
```

## dts/bindings/pinctrl/nxp,lpc17xx.yaml
```yaml
---
title: lpc17xx Pinmux
id: nxp,lpc17xx-pinmux
version: 0.1

description: >
    This is a representation of the LPC17XX Pinmux node

properties:
    compatible:
      type: string
      category: required
      description: compatible strings
      constraint: "nxp,lpc17xx-pinmux"

    reg:
      type: int
      description: mmio register space
      generation: define
      category: required

    clocks:
      type: array
      description: clock gate information
      generation: define
      category: required

"#cells":
  - pin
  - function
...
```

## dts/bindings/serial/nxp,lpc17xx-uart.yaml
```yaml
#
# Copyright (c) 2018, Zilogic Systems
#
# SPDX-License-Identifier: Apache-2.0
#
---
title: LPC17XX UART
id: nxp,lpc17xx-uart
version: 0.1

description: >
    This binding gives a base representation of the LPC17XX UART.

inherits:
    !include uart.yaml

properties:
    compatible:
      type: string
      category: required
      description: compatible strings
      constraint: "nxp,lpc17xx-uart"

    reg:
      type: array
      description: mmio register space
      generation: define
      category: required
...
```

## dts/bindings/spi/nxp,lpc17xx-spi.yaml
```yaml
#
# Copyright (c) 2018, Zilogic Systems
#
# SPDX-License-Identifier: Apache-2.0
#
---
title: NXP LPC17XX
id: nxp,lpc17xx-spi
version: 0.1

description: >
    This binding gives a base representation of the NXP LPC SPI controller

inherits:
    !include spi.yaml

properties:
    compatible:
      type: string
      category: required
      description: compatible strings
      constraint: "nxp,lpc17xx-spi"

    reg:
      type: array
      description: mmio register space
      generation: define
      category: required

    interrupts:
      type: array
      category: required
      description: required interrupts
      generation: define
...
```

## soc/arm/nxp_lpc/lpc17xx/Kconfig.defconfig.lpc1769
```kconfig
if SOC_LPC1769

config SOC
       string
       default "lpc1769"

if CLOCK_CONTROL

config CLOCK_CONTROL_LPC17XX
	def_bool y

endif # CLOCK_CONTROL

if PINMUX

config PINMUX_LPC17XX
	def_bool y

endif # PINMUX

if SERIAL

config UART_LPC17XX
	def_bool y

endif # SERIAL

if SPI

config SPI_LPC17XX
	def_bool y

endif # SPI

if GPIO

config GPIO_LPC17XX
	def_bool y

endif # GPIO

if I2C

config I2C_LPC17XX
	def_bool y

endif # i2C

endif
```

## soc/arm/nxp_lpc/lpc17xx/Kconfig.defconfig.series
```kconfig
if SOC_SERIES_LPC17XX

config SOC_SERIES
	default "lpc17xx"

config NUM_IRQS
	int
	# must be >= the highest interrupt number used
	default 40

gsource "soc/arm/nxp_lpc/lpc17xx/Kconfig.defconfig.lp*"

endif # SOC_SERIES_LPC17XX
```

## soc/arm/nxp_lpc/lpc17xx/Kconfig.soc
```kconfig
choice
prompt "LPC LPC17XX MCU Selection"
depends on SOC_SERIES_LPC17XX

config SOC_LPC1769
	bool "SOC_LPC1769"
	select CPU_CORTEX_M3

endchoice

config SYS_CRYSTAL_FREQ
       int "Crystal frequency"
       default "12000000"
```
